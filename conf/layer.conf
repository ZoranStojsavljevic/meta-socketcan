## conf/layer.conf
```bitbake
# We have a conf and classes directory, add to BBPATH
BBPATH .= ":${LAYERDIR}"

# We have recipes-* directories, add to BBFILES
BBFILES += "${LAYERDIR}/recipes-*/*/*.bb \\
            ${LAYERDIR}/recipes-*/*/*.bbappend"

BBFILE_COLLECTIONS += "meta-socketcan"
BBFILE_PATTERN_meta-socketcan = "^${LAYERDIR}/"
BBFILE_PRIORITY_meta-socketcan = "6"

LAYERSERIES_COMPAT_meta-socketcan = "sumo thud warrior zeus"
```
